/**
 * @cliArgs --board "/ti/boards/CC1352R1_LAUNCHXL" --product "simplelink_cc13x2_26x2_sdk@4.30.00.54"
 * @versions {"data":"2020090214","timestamp":"2020090214","tool":"1.6.0+1543","templates":"2020090214"}
 */

/**
 * Import the modules used in this configuration.
 */
const Display  = scripting.addModule("/ti/display/Display", {}, false);
const Display1 = Display.addInstance();
const ADC      = scripting.addModule("/ti/drivers/ADC", {}, false);
const ADC1     = ADC.addInstance();
const GPIO     = scripting.addModule("/ti/drivers/GPIO");
const GPIO1    = GPIO.addInstance();
const GPIO2    = GPIO.addInstance();
const GPIO3    = GPIO.addInstance();
const Power    = scripting.addModule("/ti/drivers/Power");
const RTOS     = scripting.addModule("/ti/drivers/RTOS");

/**
 * Write custom configuration values to the imported modules.
 */
Display1.$name                    = "CONFIG_Display_0";
Display1.$hardware                = system.deviceData.board.components.XDS110UART;
Display1.uart.$name               = "CONFIG_UART_0";
Display1.uart.txPinInstance.$name = "CONFIG_PIN_2";
Display1.uart.rxPinInstance.$name = "CONFIG_PIN_3";

ADC1.$name                = "CONFIG_ADC_0";
ADC1.adcPinInstance.$name = "CONFIG_PIN_1";

GPIO1.$hardware          = system.deviceData.board.components.LED_RED;
GPIO1.$name              = "CONFIG_GPIO_LED_0";
GPIO1.initialOutputState = "High";
GPIO1.pinInstance.$name  = "CONFIG_PIN_0";

GPIO2.$name              = "CONFIG_GPIO_LED_1";
GPIO2.$hardware          = system.deviceData.board.components.LED_GREEN;
GPIO2.initialOutputState = "High";
GPIO2.pinInstance.$name  = "CONFIG_PIN_4";

GPIO3.mode               = "Output";
GPIO3.$name              = "CONFIG_GPIO_LED_B";
GPIO3.initialOutputState = "High";
GPIO3.pinInstance.$name  = "CONFIG_PIN_5";

const CCFG              = scripting.addModule("/ti/devices/CCFG", {}, false);
CCFG.ccfgTemplate.$name = "ti_devices_CCFGTemplate0";

/**
 * Pinmux solution for unlocked pins/peripherals. This ensures that minor changes to the automatic solver in a future
 * version of the tool will not impact the pinmux you originally saw.  These lines can be completely deleted in order to
 * re-solve from scratch.
 */
Display1.uart.uart.$suggestSolution       = "UART0";
Display1.uart.uart.txPin.$suggestSolution = "boosterpack.4";
Display1.uart.uart.rxPin.$suggestSolution = "boosterpack.3";
ADC1.adc.$suggestSolution                 = "ADC0";
ADC1.adc.adcPin.$suggestSolution          = "boosterpack.2";
GPIO1.gpioPin.$suggestSolution            = "boosterpack.39";
GPIO2.gpioPin.$suggestSolution            = "boosterpack.40";
GPIO3.gpioPin.$suggestSolution            = "boosterpack.19";
